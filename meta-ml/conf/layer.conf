## meta-ml/conf/layer.conf
```bitbake
# We have a conf and classes directory, add to BBPATH
BBPATH .= ":${LAYERDIR}"

# We have a packages directory, add to BBFILES
BBFILES += "${@bb.utils.contains_any('MACHINE', '${BSP_NXP_DERIVED}', '${LAYERDIR}/recipes-*/*/*.bb', '', d)}"
BBFILES += "${@bb.utils.contains_any('MACHINE', '${BSP_NXP_DERIVED}', '${LAYERDIR}/recipes-*/*/*.bbappend', '', d)}"

BBMASK += "${LAYERDIR}/recipes-fsl/"

BBFILE_COLLECTIONS += "meta-ml"
BBFILE_PATTERN_meta-ml := "^${LAYERDIR}/"
BBFILE_PRIORITY_meta-ml = "5"

RECIPE_LIST_REASON:meta-ml = "You are about to enable third-party components, there is additional third-part licensing involved, and you might need to consult with your legal department."

LAYERSERIES_COMPAT_meta-ml = "warrior zeus gatesgarth hardknott honister kirkstone"
```

## meta-sdk/conf/layer.conf
```bitbake
# We have a conf and classes directory, add to BBPATH
BBPATH .= ":${LAYERDIR}"

# We have a packages directory, add to BBFILES
BBFILES += "${@bb.utils.contains_any('MACHINE', '${BSP_NXP_DERIVED}', '${LAYERDIR}/recipes-*/*/*.bb', '', d)}"
BBFILES += "${@bb.utils.contains_any('MACHINE', '${BSP_NXP_DERIVED}', '${LAYERDIR}/recipes-*/*/*.bbappend', '', d)}"

BBFILE_COLLECTIONS += "fsl-sdk-release"
BBFILE_PATTERN_fsl-sdk-release := "^${LAYERDIR}/"
BBFILE_PRIORITY_fsl-sdk-release = "5"
LAYERSERIES_COMPAT_fsl-sdk-release = "kirkstone"

BBMASK += "${LAYERDIR}/recipes-fsl/"
BBMASK += "${LAYERDIR}/recipes-connectivity/"
BBMASK += "${LAYERDIR}/recipes-extended/(?!dpdk)"
BBMASK += "${LAYERDIR}/dynamic-layers/"
BBMASK += "${LAYERDIR}/recipes-devtools/"
BBMASK += "${LAYERDIR}/recipes-sato/"

RECIPE_LIST_REASON:fsl-sdk-release = "You are about to enable third-party components, there is additional third-part licensing involved, and you might need to consult with your legal department."

# FIXME: Drop these lines as external layers are properly marked for kirkstone
LAYERSERIES_COMPAT_chromium-browser-layer:append = " kirkstone"
LAYERSERIES_COMPAT_imx-demo:append = " kirkstone"
LAYERSERIES_COMPAT_qt6-layer:append = " kirkstone"

BBFILES_DYNAMIC += " \
    chromium-browser-layer:${LAYERDIR}/dynamic-layers/chromium-browser-layer/*/*/*.bb \
    chromium-browser-layer:${LAYERDIR}/dynamic-layers/chromium-browser-layer/*/*/*.bbappend \
    \
    openembedded-layer:${LAYERDIR}/dynamic-layers/openembedded-layer/*/*/*.bb \
    openembedded-layer:${LAYERDIR}/dynamic-layers/openembedded-layer/*/*/*.bbappend \
    \
    qt6-layer:${LAYERDIR}/dynamic-layers/qt6-layer/*/*/*.bb \
    qt6-layer:${LAYERDIR}/dynamic-layers/qt6-layer/*/*/*.bbappend \
"

BBMASK += " \
    meta-freescale-distro/recipes-fsl/packagegroups/packagegroup-fsl-tools-gpu-external.bb \
"
```
